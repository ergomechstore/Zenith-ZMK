## boards/shields/totem/Kconfig.shield
```kconfig
# Copyright (c) 2025 The ZMK Contributors
# SPDX-License-Identifier: MIT

config SHIELD_TOTEM_DONGLE
    def_bool $(shields_list_contains,zenith_dongle)

config SHIELD_TOTEM_LEFT
    def_bool $(shields_list_contains,zenith_left)

config SHIELD_TOTEM_RIGHT
    def_bool $(shields_list_contains,zenith_right)
```
